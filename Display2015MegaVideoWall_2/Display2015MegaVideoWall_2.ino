#include <SPI.h>
#include <SD.h>

File myFile;

#define COLOR(r,g,b)     ((r)+((g)<<4)+((b)<<8))  //Color is 12-bit (4-bit each R, G, B)
#define black     COLOR(0,0,0)  
#define red          COLOR(0xf,0,0)  
#define green     COLOR(0,0xf,0)  
#define blue          COLOR(0,0,0xf)  
#define teal          COLOR(0,0xf,0xf)  
#define magenta     COLOR(0xf,0,0xf)
#define pink     COLOR(0xf,0x2,0xf)
#define yellow     COLOR(0xf,0xf,0)
#define purple     COLOR(0xa,0x0,0xf)
#define orange    COLOR(0xf,0x3,0x0)
#define warmWhite     COLOR(0xf,0x7,0x2)
#define white		COLOR(0xd, 0xd, 0xd)
#define lightCount      48             //50, only need 48 out of 50 for 24 x 48 pixel display
#define defaultIntensity      0xcc
#define delayShort      6      //6 orig.
#define delayLong      12      //12 orig.
#define delayShort_2      3      //3 orig.
#define delayLong_2      16      //16 orig.

const int rgb[] = {COLOR(15, 0, 0), COLOR(15, 1, 0), COLOR(15, 2, 0), COLOR(15, 3, 0), COLOR(15, 4, 0), COLOR(15, 5, 0), COLOR(15, 6, 0), COLOR(15, 7, 0), COLOR(15, 8, 0), COLOR(15, 9, 0),
COLOR(15, 10, 0), COLOR(15, 11, 0), COLOR(15, 12, 0), COLOR(15, 13, 0), COLOR(15, 14, 0), COLOR(15, 15, 0), COLOR(14, 15, 0), COLOR(13, 15, 0), COLOR(12, 15, 0), COLOR(11, 15, 0),
COLOR(10, 15, 0), COLOR(9, 15, 0), COLOR(8, 15, 0), COLOR(7, 15, 0), COLOR(6, 15, 0), COLOR(5, 15, 0), COLOR(4, 15, 0), COLOR(3, 15, 0), COLOR(2, 15, 0), COLOR(1, 15, 0), COLOR(0, 15, 0),
COLOR(0, 15, 1), COLOR(0, 15, 2), COLOR(0, 15, 3), COLOR(0, 15, 4), COLOR(0, 15, 5), COLOR(0, 15, 6), COLOR(0, 15, 7), COLOR(0, 15, 8), COLOR(0, 15, 9), COLOR(0, 15, 10), COLOR(0, 15,11),
COLOR(0, 15, 12), COLOR(0, 15, 13), COLOR(0, 15, 14), COLOR(0, 15, 15), COLOR(0, 14, 15), COLOR(0, 13, 15), COLOR(0, 12, 15), COLOR(0, 11, 15), COLOR(0, 10, 15), COLOR(0, 9, 15),
COLOR(0, 8, 15), COLOR(0, 7, 15), COLOR(0, 6, 15), COLOR(0, 5, 15), COLOR(0, 4, 15), COLOR(0, 3, 15), COLOR(0, 2, 15), COLOR(0, 1, 15), COLOR(0, 0, 15), COLOR(1, 0, 15), COLOR(2, 0, 15),
COLOR(3, 0, 15), COLOR(4, 0, 15), COLOR(5, 0, 15), COLOR(6, 0, 15), COLOR(7, 0, 15), COLOR(8, 0, 15), COLOR(9, 0, 15), COLOR(10, 0, 15), COLOR(11, 0, 15), COLOR(12, 0, 15), COLOR(13, 0, 15),
COLOR(14, 0, 15), COLOR(15, 0, 15), COLOR(15, 0, 14), COLOR(15, 0, 13), COLOR(15, 0, 12), COLOR(15, 0, 11), COLOR(15, 0, 10), COLOR(15, 0, 9), COLOR(15, 0, 8), COLOR(15, 0, 7),
COLOR(15, 0, 6), COLOR(15, 0, 5), COLOR(15, 0, 4), COLOR(15, 0, 3), COLOR(15, 0, 2), COLOR(15, 0, 1)};

/*const int redFade[] = {COLOR(0, 0, 0), COLOR(1, 0, 0), COLOR(2, 0, 0), COLOR(3, 0, 0), COLOR(4, 0, 0), COLOR(5, 0, 0), COLOR(6, 0, 0), COLOR(7, 0, 0), COLOR(8, 0, 0), COLOR(9, 0, 0), 
COLOR(10, 0, 0), COLOR(11, 0, 0), COLOR(12, 0, 0), COLOR(13, 0, 0), COLOR(14, 0, 0), COLOR(15, 0, 0), COLOR(14, 0, 0), COLOR(13, 0, 0), COLOR(12, 0, 0), COLOR(11, 0, 0), COLOR(10, 0, 0),
COLOR(9, 0, 0), COLOR(8, 0, 0), COLOR(7, 0, 0), COLOR(6, 0, 0), COLOR(5, 0, 0), COLOR(4, 0, 0), COLOR(3, 0, 0), COLOR(2, 0, 0), COLOR(1, 0, 0)};

const int yellowFade[] = {COLOR(0, 0, 0), COLOR(1, 1, 0), COLOR(2, 2, 0), COLOR(3, 3, 0), COLOR(4, 4, 0), COLOR(5, 5, 0), COLOR(6, 6, 0), COLOR(7, 7, 0), COLOR(8, 8, 0), COLOR(9, 9, 0),
COLOR(10, 10, 0), COLOR(11, 11, 0), COLOR(12, 12, 0), COLOR(13, 13, 0), COLOR(14, 14, 0), COLOR(15, 15, 0), COLOR(14, 14, 0), COLOR(13, 13, 0), COLOR(12, 12, 0), COLOR(11, 11, 0),
COLOR(10, 10, 0), COLOR(9, 9, 0), COLOR(8, 8, 0), COLOR(7, 7, 0), COLOR(6, 6, 0), COLOR(5, 5, 0), COLOR(4, 4, 0), COLOR(3, 3, 0), COLOR(2, 2, 0), COLOR(1, 1, 0)};

const int greenFade[] = {COLOR(0, 0, 0), COLOR(0, 1, 0), COLOR(0, 2, 0), COLOR(0, 3, 0), COLOR(0, 4, 0), COLOR(0, 5, 0), COLOR(0, 6, 0), COLOR(0, 7, 0), COLOR(0, 8, 0), COLOR(0, 9, 0),
COLOR(0, 10, 0), COLOR(0, 11, 0), COLOR(0, 12, 0), COLOR(0, 13, 0), COLOR(0, 14, 0), COLOR(0, 15, 0), COLOR(0, 14, 0), COLOR(0, 13, 0), COLOR(0, 12, 0), COLOR(0, 11, 0), COLOR(0, 10, 0),
COLOR(0, 9, 0), COLOR(0, 8, 0), COLOR(0, 7, 0), COLOR(0, 6, 0), COLOR(0, 5, 0), COLOR(0, 4, 0), COLOR(0, 3, 0), COLOR(0, 2, 0), COLOR(0, 1, 0)};

const int tealFade[] = {COLOR(0, 0, 0), COLOR(0, 1, 1), COLOR(0, 2, 2), COLOR(0, 3, 3), COLOR(0, 4, 4), COLOR(0, 5, 5), COLOR(0, 6, 6), COLOR(0, 7, 7), COLOR(0, 8, 8), COLOR(0, 9, 9),
COLOR(0, 10, 10), COLOR(0, 11, 11), COLOR(0, 12, 12), COLOR(0, 13, 13), COLOR(0, 14, 14), COLOR(0, 15, 15), COLOR(0, 14, 14), COLOR(0, 13, 13), COLOR(0, 12, 12), COLOR(0, 11, 11),
COLOR(0, 10, 10), COLOR(0, 9, 9), COLOR(0, 8, 8), COLOR(0, 7, 7), COLOR(0, 6, 6), COLOR(0, 5, 5), COLOR(0, 4, 4), COLOR(0, 3, 3), COLOR(0, 2, 2), COLOR(0, 1, 1)};

const int blueFade[] = {COLOR(0, 0, 0), COLOR(0, 0, 1), COLOR(0, 0, 2), COLOR(0, 0, 3), COLOR(0, 0, 4), COLOR(0, 0, 5), COLOR(0, 0, 6), COLOR(0, 0, 7), COLOR(0, 0, 8), COLOR(0, 0, 9),
COLOR(0, 0, 10), COLOR(0, 0, 11), COLOR(0, 0, 12), COLOR(0, 0, 13), COLOR(0, 0, 14), COLOR(0, 0, 15), COLOR(0, 0, 14), COLOR(0, 0, 13), COLOR(0, 0, 12), COLOR(0, 0, 11), COLOR(0, 0, 10),
COLOR(0, 0, 9), COLOR(0, 0, 8), COLOR(0, 0, 7), COLOR(0, 0, 6), COLOR(0, 0, 5), COLOR(0, 0, 4), COLOR(0, 0, 3), COLOR(0, 0, 2), COLOR(0, 0, 1)};

const int magentaFade[] = {COLOR(0, 0, 0), COLOR(1, 0, 1), COLOR(2, 0, 2), COLOR(3, 0, 3), COLOR(4, 0, 4), COLOR(5, 0, 5), COLOR(6, 0, 6), COLOR(7, 0, 7), COLOR(8, 0, 8), COLOR(9, 0, 9),
COLOR(10, 0, 10), COLOR(11, 0, 11), COLOR(12, 0, 12), COLOR(13, 0, 13), COLOR(14, 0, 14), COLOR(15, 0, 15), COLOR(14, 0, 14), COLOR(13, 0, 13), COLOR(12, 0, 12), COLOR(11, 0, 11),
COLOR(10, 0, 10), COLOR(9, 0, 9), COLOR(8, 0, 8), COLOR(7, 0, 7), COLOR(6, 0, 6), COLOR(5, 0, 5), COLOR(4, 0, 4), COLOR(3, 0, 3), COLOR(2, 0, 2), COLOR(1, 0, 1)};

const int whiteFade[] = {COLOR(0, 0, 0), COLOR(1, 1, 1), COLOR(2, 2, 2), COLOR(3, 3, 3), COLOR(4, 4, 4), COLOR(5, 5, 5), COLOR(6, 6, 6), COLOR(7, 7, 7), COLOR(8, 8, 8), COLOR(9, 9, 9),
COLOR(10, 10, 10), COLOR(11, 11, 11), COLOR(12, 12, 12), COLOR(13, 13, 13), COLOR(14, 14, 14), COLOR(15, 15, 15), COLOR(14, 14, 14), COLOR(13, 13, 13), COLOR(12, 12, 12), COLOR(11, 11, 11),
COLOR(10, 10, 10), COLOR(9, 9, 9), COLOR(8, 8, 8), COLOR(7, 7, 7), COLOR(6, 6, 6), COLOR(5, 5, 5), COLOR(4, 4, 4), COLOR(3, 3, 3), COLOR(2, 2, 2), COLOR(1, 1, 1)};
*/

int a[48][12] = {0x00, 0x00, 0x00, 0x00, 0x00, 0x00, 0x00, 0x00, 0x00, 0x00, 0x00, 0x00,  //0
                  0x00, 0x00, 0x00, 0x00, 0x00, 0x00, 0x00, 0x00, 0x00, 0x00, 0x00, 0x00,  //1
                  0x00, 0x00, 0x00, 0x00, 0x00, 0x00, 0x00, 0x00, 0x00, 0x00, 0x00, 0x00,  //2
                  0x00, 0x00, 0x00, 0x00, 0x00, 0x00, 0x00, 0x00, 0x00, 0x00, 0x00, 0x00,  //3
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                  0x00, 0x00, 0x00, 0x00, 0x00, 0x00, 0x00, 0x00, 0x00, 0x00, 0x00, 0x00};  //47


int c[48][12] = {0x00, 0x00, 0x00, 0x00, 0x00, 0x00, 0x00, 0x00, 0x00, 0x00, 0x00, 0x00,  //0
                  0x00, 0x00, 0x00, 0x00, 0x00, 0x00, 0x00, 0x00, 0x00, 0x00, 0x00, 0x00,  //1
                  0x00, 0x00, 0x00, 0x00, 0x00, 0x00, 0x00, 0x00, 0x00, 0x00, 0x00, 0x00,  //2
                  0x00, 0x00, 0x00, 0x00, 0x00, 0x00, 0x00, 0x00, 0x00, 0x00, 0x00, 0x00,  //3
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                  0x00, 0x00, 0x00, 0x00, 0x00, 0x00, 0x00, 0x00, 0x00, 0x00, 0x00, 0x00};  //47


int l[48][12] = {0x00, 0x00, 0x00, 0x00, 0x00, 0x00, 0x00, 0x00, 0x00, 0x00, 0x00, 0x00,  //0
                  0x00, 0x00, 0x00, 0x00, 0x00, 0x00, 0x00, 0x00, 0x00, 0x00, 0x00, 0x00,  //1
                  0x00, 0x00, 0x00, 0x00, 0x00, 0x00, 0x00, 0x00, 0x00, 0x00, 0x00, 0x00,  //2
                  0x00, 0x00, 0x00, 0x00, 0x00, 0x00, 0x00, 0x00, 0x00, 0x00, 0x00, 0x00,  //3
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                  0x00, 0x00, 0x00, 0x00, 0x00, 0x00, 0x00, 0x00, 0x00, 0x00, 0x00, 0x00};  //47

//byte *addressPtr;

void beginAll(){          //begins the data frame for all outputs on PORTA, PORTC and PORTL
  PORTA = B11111111;
  PORTC = B11111111;
  PORTL = B11111111;
  delayMicroseconds(delayShort);  //Output should be ~ 10uS long
  PORTA = B00000000;
  PORTC = B00000000;
  PORTL = B00000000;
}

void zeroAll(){
  PORTA = B00000000;
  PORTC = B00000000;
  PORTL = B00000000;
  delayMicroseconds(delayShort_2);  //Output should be ~ 10uS long
  PORTA = B11111111;
  PORTC = B11111111;
  PORTL = B11111111;
  delayMicroseconds(delayLong_2); //Output should be ~ 20uS long
  PORTA = B00000000;
  PORTC = B00000000;
  PORTL = B00000000;
}

void oneAll(){
  PORTA = B00000000;
  PORTC = B00000000;
  PORTL = B00000000; 
  delayMicroseconds(delayLong);    //Output should be ~ 20uS long
  PORTA = B11111111;
  PORTC = B11111111;
  PORTL = B11111111;
  delayMicroseconds(delayShort);    //Output should be ~ 10uS long
  PORTA = B00000000;
  PORTC = B00000000;
  PORTL = B00000000;
}

void endAll(){            //sets the data line LOW between data frames
  PORTA = B00000000;
  PORTC = B00000000;
  PORTL = B00000000;
  delayMicroseconds(30);
}

void zeroOne(byte byteA, byte byteC, byte byteL){            //
  PORTA = B00000000;
  PORTC = B00000000;
  PORTL = B00000000; 
  delayMicroseconds(7); //Output should be ~ 10uS long
  PORTA = ~byteA;
  PORTC = ~byteC;
  PORTL = ~byteL;
  delayMicroseconds(7);  //Output should be ~ 10uS long
  PORTA = B11111111;
  PORTC = B11111111;
  PORTL = B11111111;
  delayMicroseconds(7);  //Output should be ~ 10uS long
}

/*void enumerateAll(byte led, byte intensity, byte color){
  beginAll();
  
  for (int i = 6; i; i--, (led <<= 1))
    if (led & (1 << 5))
      oneAll();
    else
      zeroAll();
  
  for (int i = 8; i; i--, (intensity <<= 1))
    if (intensity & (1 << 7))
      oneAll();
    else
      zeroAll();
  
  for (int i = 12; i; i--, (color <<= 1))
    if (led & (1 << 11))
      oneAll();
    else
      zeroAll();
      
  endAll();
}
*/

void enumerateAll(){       //addresses each bulb individually for all outputs
   fillColorAll(0, lightCount, defaultIntensity, black);
}

void setColor(byte led, byte intensity){
  beginAll();
  
  for (int i = 6; i; i--, (led <<= 1))
    if (led & (1 << 5))
      oneAll();
    else
      zeroAll();
  
  for (int i = 8; i; i--, (intensity <<= 1))
    if (intensity & (1 << 7))
      oneAll();
    else
      zeroAll();
  
  for (int i = 0; i<12; i++)
    zeroOne(a[i-1][led], c[i-1][led], l[i-1][led]);
    
  endAll();
}

/*void USFlag(){
  myFile = SD.open("USFlag_24x48", FILE_READ);
  for (int i = 0; i < lightCount; i++){
    for (int j = 0; j < 12; j++){
      a[576] = myFile.read();
    }
  }
  for (int i = 0; i < lightCount; i++){
    for (int j = 0; j < 12; j++){
      c[576] = myFile.read();
    }
  }
  for (int i = 0; i < lightCount; i++){
    for (int j = 0; j < 12; j++){
      l[576] = myFile.read();
    }
  }
  myFile.close();
  for (int i = 0; i < lightCount; i++)
    setColor(i);
}
*/

void setColorAll(uint8_t led, uint8_t intensity, uint16_t color){                   //sets the color and intensity for a specific bulb on all outputs of PORTC and PORTL
  uint8_t i;  
  beginAll();  
  for(i=6;i;i--,(led<<=1))  
    if(led&(1<<5)) oneAll();  
    else zeroAll();
  for(i=8;i;i--,(intensity<<=1))  
    if(intensity&(1<<7)) oneAll();  
    else zeroAll();
  for(i=12;i;i--,(color<<=1))  
    if(color&(1<<11)) oneAll();  
    else zeroAll();
  endAll();  
}

void fillColorAll(uint8_t begin, uint8_t count, uint8_t intensity, uint16_t color){ //fills the string with a color and intensity starting from a specific bulb to the end of the string
  while(count--){                                                                   //for all outputs on PORTC and PORTL
    setColorAll(begin++, intensity, color);  
  }
}

///////////////////////////////////////////////////////////////////////////////////////////////////////////////////////////////////////////////////////////////////////////////////
//------------------------------------------------------------------------------------SETUP--------------------------------------------------------------------------------------//
///////////////////////////////////////////////////////////////////////////////////////////////////////////////////////////////////////////////////////////////////////////////////


void setup(){
  
  DDRA = B11111111;
  DDRC = B11111111;
  DDRL = B11111111;
  pinMode(53, OUTPUT);

  delay(500);
  
  noInterrupts();
//  for (int i = 0; i < lightCount; i++) enumerateAll(i, intensity, white);            //Enumerate lights on string to enable individual bulb addressing
    enumerateAll();
  interrupts();
  
  SD.begin();          //use hardware cs pin 53 for Mega 2560
                       //CLK --> 52
                       //DO  --> 50
                       //DI  --> 51
                       //CS  --> 53
  
  noInterrupts();
  fillColorAll(0, lightCount, defaultIntensity, white);
  interrupts();
  delay(3000);
}


///////////////////////////////////////////////////////////////////////////////////////////////////////////////////////////////////////////////////////////////////////////////////
//------------------------------------------------------------------------------------LOOP---------------------------------------------------------------------------------------//
///////////////////////////////////////////////////////////////////////////////////////////////////////////////////////////////////////////////////////////////////////////////////


void loop() {
//  USFlag();
//  delay(30000);
  noInterrupts();
  fillColorAll(0, lightCount, defaultIntensity, red);
  interrupts();
  delay(500);
  noInterrupts();
  fillColorAll(0, lightCount, defaultIntensity, white);
  interrupts();
  delay(500);
  noInterrupts();
  fillColorAll(0, lightCount, defaultIntensity, green);
  interrupts();
  delay(500);
  noInterrupts();
  fillColorAll(0, lightCount, defaultIntensity, white);
  interrupts();
  delay(500);
  noInterrupts();
  for (int i = 0; i < lightCount; i++) setColor(i, defaultIntensity);
  interrupts();
  delay(1000);

}
